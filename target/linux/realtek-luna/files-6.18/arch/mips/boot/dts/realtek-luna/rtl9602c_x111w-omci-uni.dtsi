// SPDX-License-Identifier: GPL-2.0-or-later
/* The X111W's OMCI panel, a node of the root: its board tree and its virtual unit include it where it sits, so both declare one panel. */
	/*
	 * The UNI panel this board presents over OMCI, MEASURED from its own
	 * stock firmware (omcicli mib get 11/264, 2026-09-12, archived under
	 * results/RTL9602C/HSGQ/X111W/uni-runtime-20260912/).
	 *
	 * TWO Ethernet UNIs here, not four -- this board has one GE and one FE
	 * socket -- and FOUR UNI-Gs, two of which have no Ethernet UNI beside
	 * them.  Its management capabilities are 1, 1, 2 and 0: the value is
	 * not a flag, which is why it is carried per instance.
	 * PhysicalPortId runs 1 then 0 over 0x0101, 0x0102.
	 */
	omci-uni {
		ethernet-uni-instances = /bits/ 16 <0x0101 0x0102>;
		/* The SWITCH PORT each of those instances is, from this board's own PhysicalPortId.  ⚠ WEAKER EVIDENCE than the other two:
		 * no mapper replay has been run here, so this is what stock REPORTS.
		 * ⚠ NEVER COMPUTED: the two Luna boards and the Cortina one run
		 * their port order in OPPOSITE directions, and one numbers its
		 * fourth UNI 0x0401, so no arithmetic on an instance id is
		 * right on more than one board. */
		ethernet-uni-ports = /bits/ 8 <1 0>;
		/* G.988 plug-in type per instance, from this board's own stock:
		 * 0x0101 is the GE port (47) and 0x0102 the FE one (24).  It states
		 * what the UNI IS, so it does not follow the link. */
		ethernet-uni-types = /bits/ 8 <47 24>;
		uni-g-instances = /bits/ 16 <0x0101 0x0102 0x0202 0x0602>;
		uni-g-management-capability = /bits/ 8 <1 1 2 0>;
		/* The equipment slots stock's ME 5/6 report, from which the OLT
		 * counts 2 Ethernet and 1 POTS port and 24/96 priority queues:
		 * instance, plug-in type, ports, priority queues, T-CONT
		 * buffers, schedulers.  The PON pack's counts are the board
		 * default; a unit's own stock counts arrive in
		 * luna_gpon.onu_capacity (lab M225-260515 12/96/12, field
		 * M225-260618 16/128/16). */
		circuit-packs = /bits/ 16 <
			0x0101  47 1  8  0  0
			0x0102  32 1  0  0  0
			0x0104  24 1  8  0  0
			0x0106  48 1  8  0  0
			0x010b  38 1  0  0  0
			0x0180 248 1 96 12 12>;
		/* ME 134 IP host config data, as stock reports it: three
		 * instances, the first two carrying the WAN MAC. */
		wifi-radios = /bits/ 8 <1>;
		ip-host-instances = /bits/ 16 <0x0000 0x0001 0x0002>;
		ip-host-wan-mac = /bits/ 8 <1 1 0>;
		/* ME 53: stock reports one POTS UNI, and the OLT counts it. */
		pots-uni-instances = /bits/ 16 <0x0201>;
		/* ANI-G #2 and ONU2-G #6/#7/#9 as stock declares them, and its
		 * downstream queue blocks in order. */
		onu-capacity = /bits/ 16 <12 96 12 64>;
		downstream-queue-ports = /bits/ 16 <0x0101 0x0102 0x0601>;
		/* Further MEs stock's MIB upload reports, <class instance> (field
		 * X111W, production OLT, 2026-10-02): PPTP LCT UNI, ONU power
		 * shedding, VoIP config data, VoIP line status of the POTS port,
		 * TR-069 server of the VEIP; then the vendor MEs an OLT is known to
		 * use: ZTE extended ONU-G, Huawei 350, ZTE SNTP, HSGQ ONU support,
		 * FiberHome ONU, Huawei capability declaration. */
		extra-me-instances = /bits/ 16 <83 0  133 0  138 0  141 0x0201  340 0x0601
			247 0  350 0  65294 0  65352 0  65363 0  65427 0xff80>;
	};
