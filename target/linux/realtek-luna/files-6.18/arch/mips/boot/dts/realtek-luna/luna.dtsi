// SPDX-License-Identifier: GPL-2.0-or-later
/*
 * Realtek Luna (RTL960x) -- what every part of the family shares.
 *
 * ★★★ THE KERNEL COMMAND LINE IS FAMILY CONFIGURATION, NOT A BOARD FACT, AND
 * IT MUST NOT BE INHERITED FROM THE BOOTLOADER (measured 2026-08-27 on the
 * X111W).  `printenv bootargs` at that board's U-Boot prompt answers with an
 * EMPTY value -- the vendor bootloader passes the kernel NOTHING -- so
 * everything the kernel gets has to come from here.  `uboot.py`'s own comment
 * assumed the opposite ("the existing line carries console=, mtdparts= and
 * root="); that assumption is refuted for this family.
 *
 * So the line lives ONCE, here; a board that needs more adds it to its own
 * `chosen`.  console=ttyS0,115200 is the family's UART (serial@18002000).
 *
 * A unit's image carries no debug word: `earlycon` and `ignore_loglevel` cost
 * console time until the asynchronous console starts
 * (drivers/tty/serial/8250/luna_console.c), and a boot time is measured
 * without them.  The ring keeps every line (dmesg, the crash log); to read it
 * live: echo Y > /sys/module/printk/parameters/ignore_loglevel.
 * `keep_bootcon` was the O4 ranging wall of 2026-08-27: every printk shifted
 * out three times.  Guarded: ONU-test-case/guards/console_amplification_guard.py.
 */

/ {
	chosen {
		bootargs = "console=ttyS0,115200";
	};

	/* The family GPON core (luna_gpon.c) drives the optical front end from
	 * its init. A board whose PON wiring is not proven sets this "disabled":
	 * a laser keyed on an unproven board transmits into a SHARED PON. */
	gpon: gpon {
		compatible = "realtek,luna-gpon";
		status = "okay";
	};
};
