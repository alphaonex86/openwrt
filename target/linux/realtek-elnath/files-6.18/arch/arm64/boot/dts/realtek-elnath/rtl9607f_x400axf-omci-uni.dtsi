// SPDX-License-Identifier: GPL-2.0-or-later
/* The X400AXF's OMCI panel: its board tree and its virtual unit's include it, so they declare one panel. */

/ {
	/*
	 * The UNI panel this board presents over OMCI, MEASURED from its own
	 * stock firmware (omcicli mib get 11/264, 2026-09-13).
	 *
	 * ME 11 (PPTP Ethernet UNI) and ME 264 (UNI-G) are SEPARATE lists and
	 * neither is derivable from the other.  This board carries a fifth UNI-G,
	 * 0x0604, with no Ethernet UNI beside it and management capability 0
	 * where the other four report 1.  Its PhysicalPortId runs 3,2,1,0 over
	 * 0x0101..0x0104 -- the OPPOSITE order to the G24W's, which is why no
	 * code here computes a port from an instance.
	 *
	 * The ids are full 16-bit OMCI instance numbers, not port indices.
	 */
	omci-uni {
		ethernet-uni-instances = /bits/ 16 <0x0101 0x0102 0x0103 0x0104>;
		/* The SWITCH PORT each of those instances is, from this board's OWN mapper at 0x3bd08, replayed against its captured gInfo
		 * for BOTH feature-50 states, and agreeing with its own PhysicalPortId.
		 * ⚠ NEVER COMPUTED: the two Luna boards and the Cortina one run
		 * their port order in OPPOSITE directions, and one numbers its
		 * fourth UNI 0x0401, so no arithmetic on an instance id is
		 * right on more than one board. */
		ethernet-uni-ports = /bits/ 8 <3 2 1 0>;
		uni-g-instances = /bits/ 16 <0x0101 0x0102 0x0103 0x0104 0x0604>;
		uni-g-management-capability = /bits/ 8 <1 1 1 1 0>;
		/* The rest of what the OLT counts, from this board's own stock MIB
		 * (stock_gpon_oracle 2026-09-30, omci_panel.py): no circuit pack,
		 * three IP hosts without a MAC, 30 T-CONTs and schedulers, ONU2-G
		 * 248 queues / 248 GEM ports, and the downstream queue blocks in
		 * stock's order. */
		ethernet-uni-types = /bits/ 8 <47 47 47 47>;
		circuit-packs;
		ip-host-instances = /bits/ 16 <0x0000 0x0001 0x0002>;
		ip-host-wan-mac = /bits/ 8 <0 0 0>;
		onu-capacity = /bits/ 16 <30 248 30 248>;
		downstream-queue-ports = /bits/ 16 <0x0104 0x0103 0x0102 0x0101 0x0601>;
		/* stock's MIB upload and its 0x05 to an unlisted vendor ME (omci_panel.py, 2026-10-30) */
		extra-me-instances = /bits/ 16 <83 0  133 0  247 0  340 0x0601  350 0  65294 0  65352 0
			65427 0xffa0  65457 0>;
		vendor-me-absent-unknown-instance;
	};
};
