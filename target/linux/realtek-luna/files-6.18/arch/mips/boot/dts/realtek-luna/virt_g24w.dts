// SPDX-License-Identifier: GPL-2.0-or-later
/* The G24W's virtual unit: QEMU Malta boots its kernel's own tree, ponvirt reads this panel through panel_fdt. */

/dts-v1/;

/ {
	model = "LANLY G24W (virtual, QEMU Malta)";
	compatible = "lanly,g24w-virt";

	#include "rtl9603cvd_g24w-omci-uni.dtsi"
};
