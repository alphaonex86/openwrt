// SPDX-License-Identifier: GPL-2.0-or-later
/* The V2801RGW's virtual unit: QEMU Malta boots its kernel's own tree, ponvirt reads this panel through panel_fdt. */

/dts-v1/;

/ {
	model = "VSOL V2801RGW (virtual, QEMU Malta)";
	compatible = "vsol,v2801rgw-virt";

	#include "rtl9602c_v2801rgw-omci-uni.dtsi"
};
