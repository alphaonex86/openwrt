// SPDX-License-Identifier: GPL-2.0-or-later
/* The V2801RGW's OMCI panel, a node of the root: its board tree and its virtual unit include it where it sits, so both declare one panel. */
	/* What the OLT counts, from this board's own stock MIB (stock_gpon_oracle
	 * 2026-10-06, omci_panel.py): one GE UNI, and 30 upstream queues spread
	 * unevenly over 16 T-CONTs. */
	omci-uni {
		ethernet-uni-instances = /bits/ 16 <0x0101>;
		ethernet-uni-ports = /bits/ 8 <0>;
		ethernet-uni-types = /bits/ 8 <47>;
		uni-g-instances = /bits/ 16 <0x0101 0x0601 0x0501>;
		uni-g-management-capability = /bits/ 8 <1 0 1>;
		circuit-packs = /bits/ 16 <
			0x0106  48 1  8  0  0
			0x0102  32 1  0  0  0
			0x0105  40 1  0  0  0
			0x0180 248 1 64 16 16>;
		ip-host-instances = /bits/ 16 <0x0000 0x0001 0x0002>;
		ip-host-wan-mac = /bits/ 8 <0 0 0>;
		onu-capacity = /bits/ 16 <16 64 16 64>;
		downstream-queue-ports = /bits/ 16 <0x0101 0x0601>;
		upstream-queues-per-tcont = /bits/ 8 <4 4 2 1 1 1 1 1 1 1 1 1 1 2 4 4>;
		/* Stock's CTC ONU capability: HGU, TX power supply control 1 (the
		 * core serves 2 undeclared); without it the HSGQ OLT keeps the ISP
		 * ONU type it last saw. */
		ctc-onu-capability = /bits/ 8 <0 1 1 1>;
		extra-me-instances = /bits/ 16 <133 0  138 0  247 0  340 0x0601  65529 0>;
	};
