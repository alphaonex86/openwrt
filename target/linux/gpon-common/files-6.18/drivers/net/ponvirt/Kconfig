## target/linux/gpon-common/files-6.18/drivers/net/ponvirt/Kconfig
```kconfig
# SPDX-License-Identifier: GPL-2.0-only

config PON_VIRT
	bool "Virtual PON MAC (QEMU): the GPON ONU core over an Ethernet wire"
	depends on NET && VIRTIO_NET
	select GPON_CORE
	select GPON_SOFT_WAN
	select CRC32
	help
	  The PON MAC of a virtual ONU: the same gpon_* PLOAM, OMCI and GEM
	  core as the boards, carried at frame level over a NIC whose far end
	  is the host's virtual ODN (dev/virt/vodn). The WAN is gpon0. Only
	  for the realtek-*/virt subtargets; no board has this wire.

config PON_VIRT_OLT
	bool "Virtual OLT PON MAC (an OLT board's VM): the GPON OLT core over an Ethernet wire"
	depends on VIRTIO_MMIO && VIRTIO_NET
	select GPON_CORE
	select GPON_OLT_ROLE
	select CRC32
	help
	  The PON MAC of an OLT board's own VM: the gpon_* OLT port core
	  (activation, OMCI provisioning, zero-touch authorization) over a NIC
	  whose far end is the host's splitter (dev/virt/vodn --olt-vm); the
	  data path is pon0, bridged to the uplink. Only for an OLT image's
	  VM variant; no board has this wire.
```

## target/linux/zte-zx/files-6.18/arch/arm/mach-zx/Kconfig
```kconfig
# SPDX-License-Identifier: GPL-2.0-only
config ARCH_ZX
	bool "ZTE ZX GPON ONU SoCs (ZX279128)"
	depends on ARCH_MULTI_V7
	select ARM_AMBA
	select ARM_GIC
	select ARM_GLOBAL_TIMER
	select HAVE_ARM_SCU if SMP
	select HAVE_ARM_TWD if SMP
	select MIGHT_HAVE_CACHE_L2X0
	help
	  Support for the ZTE ZX279128 dual Cortex-A9 GPON ONU SoC (ZTE ZXHN F680).
```

## target/linux/zte-zx/files-6.18/drivers/net/ethernet/zte/Kconfig
```kconfig
# SPDX-License-Identifier: GPL-2.0-only
config ZX279128_ETH
	tristate "ZTE ZX279128 Ethernet"
	depends on ARCH_ZX || COMPILE_TEST
	depends on OF
	depends on I2C
	select PHYLIB
	select MDIO_BUS
	select GPON_CORE
	select GPON_SOFT_WAN
	select GPON_OPTICS_I2C
	select CRC32
	help
	  The four LAN ports of the ZTE ZX279128 SoC (ZXHN F680): its switch MACs and internal PHYs, reached
	  through its packet processor, and its GPON MAC on the common gpon_* ONU core, with its optics
	  (laser supply GPIO, SFF-8472 diagnostics over I2C).
```

## target/linux/zte-zx279221/files-6.18/drivers/net/ethernet/zte/Kconfig
```kconfig
# SPDX-License-Identifier: GPL-2.0-only
config ZX279221_IDM_ETH
	tristate "ZTE ZX279221 management Ethernet"
	depends on ARM64 || COMPILE_TEST
	depends on OF
	help
	  The management port of the ZTE ZX279221 SoC (ZXA10 C610 OLT main board): the CPU port of its
	  switch, which the boot loader configures.
```
