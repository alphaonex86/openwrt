// SPDX-License-Identifier: GPL-2.0-or-later
/* The X100DG's OMCI panel, a node of the root: its board tree and its virtual unit include it where it sits, so both declare one panel. */
	/* The OMCI panel the OLT counts, from this unit's stock MIB (omci_panel.py
	 * over its gpon-oracle 2026-10-01): without it the OLT read 5 differences. */
	omci-uni {
		ethernet-uni-instances = /bits/ 16 <0x0101>;
		ethernet-uni-ports = /bits/ 8 <1>;
		ethernet-uni-types = /bits/ 8 <47>;
		uni-g-instances = /bits/ 16 <0x0101 0x0601>;
		uni-g-management-capability = /bits/ 8 <1 0>;
		circuit-packs = /bits/ 16 <
			0x0101 47 1 8 0 0
			0x0106 48 1 8 0 0
			0x0180 248 1 128 16 16>;
		ip-host-instances = /bits/ 16 <0x0000 0x0001 0x0002>;
		ip-host-wan-mac = /bits/ 8 <0 0 0>;
		onu-capacity = /bits/ 16 <16 128 16 64>;
		downstream-queue-ports = /bits/ 16 <0x0101 0x0601>;
		/* Stock's CTC ONU capability, OnuType 1 = HGU (omcicli mib get 65529,
		 * 2026-10-06): without it the HSGQ OLT keeps the type it last saw. */
		extra-me-instances = /bits/ 16 <83 0  133 0  340 0x0601  65294 0  65363 0  65529 0>;
	};
